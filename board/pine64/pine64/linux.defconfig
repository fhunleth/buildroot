## configs/beaglev_frank_defconfig
```kconfig
BR2_riscv=y
BR2_riscv_custom=y
BR2_RISCV_ISA_CUSTOM_RVM=y
BR2_RISCV_ISA_CUSTOM_RVF=y
BR2_RISCV_ISA_CUSTOM_RVD=y
BR2_RISCV_ISA_CUSTOM_RVC=y
BR2_GLOBAL_PATCH_DIR="board/beaglev_frank/patches/"
BR2_SSP_NONE=y
BR2_TOOLCHAIN_BUILDROOT_MUSL=y
BR2_PACKAGE_HOST_LINUX_HEADERS_CUSTOM_5_10=y
BR2_GCC_VERSION_10_X=y
BR2_TOOLCHAIN_BUILDROOT_CXX=y
BR2_ROOTFS_POST_BUILD_SCRIPT="board/beaglev_frank/post-build.sh"
BR2_ROOTFS_POST_IMAGE_SCRIPT="support/scripts/genimage.sh"
BR2_ROOTFS_POST_SCRIPT_ARGS="-c board/beaglev_frank/genimage.cfg"
BR2_LINUX_KERNEL=y
BR2_LINUX_KERNEL_CUSTOM_TARBALL=y
# HEAD of the Fedora branch
BR2_LINUX_KERNEL_CUSTOM_TARBALL_LOCATION="$(call github,starfive-tech,linux,710cf052d6abda73584481d920b4b6befc7240ea)/linux-710cf052d6abda73584481d920b4b6befc7240ea.tar.gz"
#BR2_LINUX_KERNEL_DEFCONFIG="starfive_vic7100_evb_sd_net"
BR2_LINUX_KERNEL_USE_CUSTOM_CONFIG=y
BR2_LINUX_KERNEL_CUSTOM_CONFIG_FILE="board/beaglev_frank/linux.defconfig"
BR2_LINUX_KERNEL_INSTALL_TARGET=y
BR2_PACKAGE_ELIXIR=y
BR2_PACKAGE_ERLANG=y
BR2_PACKAGE_ETHTOOL=y
BR2_PACKAGE_WPA_SUPPLICANT=y
BR2_PACKAGE_WPA_SUPPLICANT_AP_SUPPORT=y
BR2_PACKAGE_WPA_SUPPLICANT_CTRL_IFACE=y
BR2_TARGET_ROOTFS_SQUASHFS=y
# BR2_TARGET_ROOTFS_TAR is not set
BR2_TARGET_BEAGLEV_DDRINIT=y
BR2_TARGET_BEAGLEV_SECONDBOOT=y
BR2_TARGET_OPENSBI=y
BR2_TARGET_OPENSBI_CUSTOM_TARBALL=y
# HEAD of the Fedora branch
BR2_TARGET_OPENSBI_CUSTOM_TARBALL_LOCATION="$(call github,starfive-tech,opensbi,2524b0ecd8684b42bc7a4c69794f40f11cbbe2a5)/opensbi-2524b0ecd8684b42bc7a4c69794f40f11cbbe2a5.tar.gz"
BR2_TARGET_OPENSBI_PLAT="starfive/vic7100"
# BR2_TARGET_OPENSBI_INSTALL_DYNAMIC_IMG is not set
# BR2_TARGET_OPENSBI_INSTALL_JUMP_IMG is not set
BR2_TARGET_OPENSBI_UBOOT_PAYLOAD=y
BR2_TARGET_UBOOT=y
BR2_TARGET_UBOOT_BUILD_SYSTEM_KCONFIG=y
BR2_TARGET_UBOOT_CUSTOM_TARBALL=y
# HEAD of the Fedora branch
BR2_TARGET_UBOOT_CUSTOM_TARBALL_LOCATION="$(call github,starfive-tech,u-boot,3f3ac01a29ad1cd5fa519d86f81daead2447f1d4)/uboot-3f3ac01a29ad1cd5fa519d86f81daead2447f1d4.tar.gz"
BR2_TARGET_UBOOT_BOARD_DEFCONFIG="starfive_vic7100_beagle_v_smode"
BR2_PACKAGE_HOST_GENIMAGE=y
BR2_PACKAGE_HOST_JH71XX_TOOLS=y
```

## configs/pine64_defconfig
```kconfig
BR2_aarch64=y
BR2_ARM_FPU_VFPV4=y
BR2_TOOLCHAIN_EXTERNAL=y
BR2_TOOLCHAIN_EXTERNAL_BOOTLIN=y
BR2_TOOLCHAIN_EXTERNAL_BOOTLIN_AARCH64_GLIBC_STABLE=y
BR2_TARGET_GENERIC_ISSUE="Welcome to PINE64"
BR2_INIT_SYSTEMD=y
BR2_TARGET_GENERIC_ROOT_PASSWD="root"
BR2_SYSTEM_DHCP="eth0"
BR2_SYSTEM_DEFAULT_PATH="/bin:/sbin:/usr/bin:/usr/sbin"
BR2_ROOTFS_POST_IMAGE_SCRIPT="support/scripts/genimage.sh"
BR2_ROOTFS_POST_SCRIPT_ARGS="-c board/pine64/pine64/genimage.cfg"
BR2_LINUX_KERNEL=y
BR2_LINUX_KERNEL_CUSTOM_VERSION=y
BR2_LINUX_KERNEL_CUSTOM_VERSION_VALUE="5.10.89"
BR2_LINUX_KERNEL_USE_CUSTOM_CONFIG=y
BR2_LINUX_KERNEL_CUSTOM_CONFIG_FILE="board/pine64/pine64/linux.defconfig"
BR2_LINUX_KERNEL_DTS_SUPPORT=y
BR2_LINUX_KERNEL_INTREE_DTS_NAME="allwinner/sun50i-a64-pine64 allwinner/sun50i-a64-pine64-plus"
BR2_LINUX_KERNEL_NEEDS_HOST_OPENSSL=y
BR2_PACKAGE_FLUTTER_ENGINE_BINARIES_FOR_ARM=y
BR2_PACKAGE_FLUTTER_EMBEDDED_LINUX=y
BR2_PACKAGE_KMSCUBE=y
BR2_PACKAGE_MESA3D=y
BR2_PACKAGE_MESA3D_GALLIUM_DRIVER_LIMA=y
BR2_PACKAGE_MESA3D_OSMESA_GALLIUM=y
BR2_PACKAGE_MESA3D_OPENGL_EGL=y
BR2_PACKAGE_MESA3D_OPENGL_ES=y
BR2_PACKAGE_OPENSSL=y
BR2_PACKAGE_LIBDRM_INSTALL_TESTS=y
BR2_PACKAGE_DROPBEAR=y
BR2_PACKAGE_WIRELESS_REGDB=y
BR2_TARGET_ROOTFS_EXT2=y
BR2_TARGET_ROOTFS_EXT2_4=y
BR2_TARGET_ROOTFS_EXT2_SIZE="128M"
# BR2_TARGET_ROOTFS_TAR is not set
BR2_TARGET_ARM_TRUSTED_FIRMWARE=y
BR2_TARGET_ARM_TRUSTED_FIRMWARE_PLATFORM="sun50i_a64"
BR2_TARGET_UBOOT=y
BR2_TARGET_UBOOT_BOARD_DEFCONFIG="pine64_plus"
BR2_TARGET_UBOOT_NEEDS_DTC=y
BR2_TARGET_UBOOT_NEEDS_PYLIBFDT=y
BR2_TARGET_UBOOT_NEEDS_ATF_BL31=y
BR2_TARGET_UBOOT_SPL=y
BR2_TARGET_UBOOT_SPL_NAME="spl/sunxi-spl.bin"
BR2_PACKAGE_HOST_DOSFSTOOLS=y
BR2_PACKAGE_HOST_GENIMAGE=y
BR2_PACKAGE_HOST_MTOOLS=y
BR2_PACKAGE_HOST_UBOOT_TOOLS=y
BR2_PACKAGE_HOST_UBOOT_TOOLS_BOOT_SCRIPT=y
BR2_PACKAGE_HOST_UBOOT_TOOLS_BOOT_SCRIPT_SOURCE="board/pine64/pine64/boot.cmd"
```

## package/flutter-embedded-linux/Config.in
```kconfig
config BR2_PACKAGE_FLUTTER_EMBEDDED_LINUX_ARCH_SUPPORTS
	bool
	default y if BR2_x86_64 || BR2_aarch64

comment "flutter-engine-binaries-for-arm needs a 64-bit architecture and a toolchain w/ dynamic library, threads"
	depends on BR2_USE_MMU # fork()
	depends on BR2_PACKAGE_FLUTTER_EMBEDDED_LINUX_ARCH_SUPPORTS
	depends on !BR2_PACKAGE_HAS_LIBEGL
	depends on BR2_STATIC_LIBS || !BR2_TOOLCHAIN_HAS_THREADS

config BR2_PACKAGE_FLUTTER_EMBEDDED_LINUX
	bool "flutter-engine-binaries-for-arm"
	depends on BR2_USE_MMU # fork()
	depends on !BR2_STATIC_LIBS
	depends on BR2_TOOLCHAIN_HAS_THREADS
	depends on BR2_PACKAGE_HAS_LIBEGL
	depends on BR2_PACKAGE_FLUTTER_EMBEDDED_LINUX_ARCH_SUPPORTS
	depends on BR2_PACKAGE_FLUTTER_ENGINE_BINARIES_FOR_ARM
	select BR2_PACKAGE_LIBINPUT
	select BR2_PACKAGE_LIBXKBCOMMON
	help
	  Embedded Linux embedding for Flutter

	  https://github.com/sony/flutter-embedded-linux
```

## package/flutter-engine-binaries-for-arm/Config.in
```kconfig
config BR2_PACKAGE_FLUTTER_ENGINE_BINARIES_FOR_ARM_ARCH_SUPPORTS
	bool
	default y if BR2_arm || BR2_aarch64

comment "flutter-engine-binaries-for-arm needs an ARM architecture and a toolchain w/ dynamic library, threads"
	depends on BR2_USE_MMU # fork()
	depends on BR2_PACKAGE_FLUTTER_ENGINE_BINARIES_FOR_ARM_ARCH_SUPPORTS
	depends on !BR2_PACKAGE_HAS_LIBEGL
	depends on BR2_STATIC_LIBS || !BR2_TOOLCHAIN_HAS_THREADS

config BR2_PACKAGE_FLUTTER_ENGINE_BINARIES_FOR_ARM
	bool "flutter-engine-binaries-for-arm"
	depends on BR2_USE_MMU # fork()
	depends on !BR2_STATIC_LIBS
	depends on BR2_TOOLCHAIN_HAS_THREADS
	depends on BR2_PACKAGE_HAS_LIBEGL
	depends on BR2_PACKAGE_FLUTTER_ENGINE_BINARIES_FOR_ARM_ARCH_SUPPORTS
	help
	  Flutter engine binaries (libflutter_engine.so) for arm and aarch64

	  https://github.com/ardera/flutter-engine-binaries-for-arm
```

## package/flutter-engine/Config.in
```kconfig
config BR2_PACKAGE_FLUTTER_ENGINE_ARCH_SUPPORTS
	bool
	default y if BR2_x86_64 || BR2_aarch64

comment "flutter-engine needs a 64-bit architecture and a toolchain w/ dynamic library, threads"
	depends on BR2_USE_MMU # fork()
	depends on BR2_PACKAGE_FLUTTER_ENGINE_ARCH_SUPPORTS
	depends on !BR2_PACKAGE_HAS_LIBEGL
	depends on BR2_STATIC_LIBS || !BR2_TOOLCHAIN_HAS_THREADS

config BR2_PACKAGE_FLUTTER_ENGINE
	bool "flutter-engine"
	depends on BR2_USE_MMU # fork()
	depends on !BR2_STATIC_LIBS
	depends on BR2_TOOLCHAIN_HAS_THREADS
	depends on BR2_PACKAGE_HAS_LIBEGL
	depends on BR2_PACKAGE_FLUTTER_ENGINE_ARCH_SUPPORTS
	select BR2_PACKAGE_OPENSSL
	help
	  Flutter is Google's SDK for crafting beautiful, fast user experiences
	  for mobile, web, and desktop from a single codebase.

	  https://github.com/flutter/engine
```

## package/flutter-pi/Config.in
```kconfig
config BR2_PACKAGE_FLUTTER_PI_ARCH_SUPPORTS
	bool
	default y if BR2_arm || BR2_aarch64

comment "flutter-pi needs an ARMarchitecture and a toolchain w/ dynamic library, threads"
	depends on BR2_USE_MMU # fork()
	depends on BR2_PACKAGE_FLUTTER_PI_ARCH_SUPPORTS
	depends on !BR2_PACKAGE_HAS_LIBEGL
	depends on BR2_STATIC_LIBS || !BR2_TOOLCHAIN_HAS_THREADS

config BR2_PACKAGE_FLUTTER_PI
	bool "flutter-pi"
	depends on BR2_USE_MMU # fork()
	depends on !BR2_STATIC_LIBS
	depends on BR2_TOOLCHAIN_HAS_THREADS
	depends on BR2_PACKAGE_HAS_LIBEGL
	depends on BR2_PACKAGE_FLUTTER_PI_ARCH_SUPPORTS
	select BR2_PACKAGE_LIBINPUT
	select BR2_PACKAGE_LIBXKBCOMMON
	select BR2_PACKAGE_XKEYBOARD_CONFIG
	select BR2_PACKAGE_FLUTTER_ENGINE_BINARIES_FOR_ARM
	help
	  A light-weight Flutter Engine Embedded for Raspberry Pi that runs without X.

	  https://github.com/ardera/flutter-pi
```
